## config/boards/shields/corne_dongle/Kconfig.defconfig
```kconfig
# Copyright (c) 2024 The ZMK Contributors
# SPDX-License-Identifier: MIT

if SHIELD_CORNE_DONGLE

config ZMK_KEYBOARD_NAME
	default "Corne Dongle"

config ZMK_SPLIT
	default y

config ZMK_SPLIT_ROLE_CENTRAL
	default y

# Number of peripherals (left + right halves)
config ZMK_SPLIT_BLE_CENTRAL_PERIPHERALS
	default 2

# Central connects to both halves + host BT profiles (2 + 5 = 7)
config BT_MAX_CONN
	default 7

config BT_MAX_PAIRED
	default 7

# Larger ACL buffer for split communication
config BT_BUF_ACL_RX_SIZE
	default 255

config BT_BUF_ACL_TX_SIZE
	default 255

endif
```

## config/boards/shields/corne_dongle/Kconfig.shield
```kconfig
# Copyright (c) 2024 The ZMK Contributors
# SPDX-License-Identifier: MIT

config SHIELD_CORNE_DONGLE
	def_bool $(shields_list_contains,corne_dongle)
```

## config/boards/shields/splitkb_aurora_corne/Kconfig.defconfig
```kconfig
# Copyright (c) 2024 The ZMK Contributors
# SPDX-License-Identifier: MIT

if SHIELD_SPLITKB_AURORA_CORNE_DONGLE_XIAO

config ZMK_KEYBOARD_NAME
	default "Aurora Corne Dongle"

config ZMK_SPLIT
	default y

config ZMK_SPLIT_ROLE_CENTRAL
	default y

config ZMK_SPLIT_BLE_CENTRAL_PERIPHERALS
	default 2

# Support up to 5 BT profiles (hosts) + 2 peripherals
config BT_MAX_CONN
	default 7

config BT_MAX_PAIRED
	default 7

# Increase buffer for split communication
config BT_BUF_ACL_RX_SIZE
	default 255

config BT_BUF_ACL_TX_SIZE
	default 255

endif
```

## config/boards/shields/splitkb_aurora_corne/Kconfig.shield
```kconfig
# Copyright (c) 2024 The ZMK Contributors
# SPDX-License-Identifier: MIT

config SHIELD_SPLITKB_AURORA_CORNE_DONGLE_XIAO
	def_bool $(shields_list_contains,splitkb_aurora_corne_dongle_xiao)
```
