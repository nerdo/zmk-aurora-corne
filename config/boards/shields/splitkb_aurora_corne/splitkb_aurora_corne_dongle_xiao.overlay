/*
 * Copyright (c) 2024 The ZMK Contributors
 * SPDX-License-Identifier: MIT
 *
 * Dongle has no physical keys - it only routes wireless from peripherals to USB
 */

/* Disable NFC for Zephyr 4.1+ compatibility with XIAO BLE */
&nfct {
	status = "disabled";
};
