// Aurora Corne-specific hardware overrides (not applicable to dongle)
&led_strip { chain-length = <24>; };

&nice_view_spi {
    cs-gpios = <&gpio0 29 GPIO_ACTIVE_HIGH>; // Assigning CS to D20
};

/*
 * FORCE 6-column layout explicitly.
 * The Corne Mini has outer columns physically removed, but we still use
 * the 6-column layout with &none for those positions. This ensures the
 * correct matrix transform is used for position calculations.
 */
/ {
    chosen {
        zmk,physical-layout = &foostan_corne_6col_layout;
    };
};
